## meta-bluechi/conf/layer.conf
```bitbake
# We have a conf and classes directory, add to BBPATH
BBPATH .= ":${LAYERDIR}"

# We have recipes-* directories, add to BBFILES
BBFILES += "${LAYERDIR}/recipes-*/*/*.bb \
            ${LAYERDIR}/recipes-*/*/*.bbappend"

BBFILE_COLLECTIONS += "bluechi-layer"
BBFILE_PATTERN_bluechi-layer = "^${LAYERDIR}/"
BBFILE_PRIORITY_bluechi-layer = "6"

LAYERDEPENDS_bluechi-layer = "\
    core \
    virtualization-layer \
    openembedded-layer \
"

LAYERSERIES_COMPAT_bluechi-layer = "kirkstone"
```
